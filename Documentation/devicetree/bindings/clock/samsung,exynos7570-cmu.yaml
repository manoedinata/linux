## Documentation/devicetree/bindings/clock/samsung,exynos7570-cmu.yaml
```yaml
# SPDX-License-Identifier: (GPL-2.0-only OR BSD-2-Clause)
%YAML 1.2
---
$id: http://devicetree.org/schemas/clock/samsung,exynos7570-cmu.yaml#
$schema: http://devicetree.org/meta-schemas/core.yaml#

title: Samsung Exynos7570 SoC clock controller

maintainers:
  - Hendra Manudinata <manoedinata@gmail.com>

description: |
  Exynos7570 clock controller is comprised of several CMU units, generating
  clocks for different domains. Those CMU units are modeled as separate device
  tree nodes, and might depend on each other. The root clock in that root tree
  is an external clock: OSCCLK (26 MHz). This external clock must be defined
  as a fixed-rate clock in dts.

  Each clock is assigned an identifier and client nodes can use this identifier
  to specify the clock which they consume. All clocks available for usage
  in clock consumer nodes are defined as preprocessor macros in
  include/dt-bindings/clock/samsung,exynos7570-cmu.h header.

properties:
  compatible:
    enum:
      - samsung,exynos7570-cmu-mif
      - samsung,exynos7570-cmu-fsys
      - samsung,exynos7570-cmu-peri

  clocks:
    items:
      - description: External reference clock (26 MHz)

  clock-names:
    items:
      - const: oscclk

  "#clock-cells":
    const: 1

  reg:
    maxItems: 1

required:
  - compatible
  - clocks
  - clock-names
  - "#clock-cells"
  - reg

additionalProperties: false

examples:
  - |
    #include <dt-bindings/clock/samsung,exynos7570-cmu.h>

    cmu_mif: clock-controller@10460000 {
        compatible = "samsung,exynos7570-cmu-mif";
        reg = <0x10460000 0x1000>;
        #clock-cells = <1>;

        clock-names = "oscclk";
        clocks = <&oscclk>;
    };
```

## Documentation/devicetree/bindings/display/panel/samsung,ea8061s.yaml
```yaml
# SPDX-License-Identifier: GPL-2.0-only OR BSD-2-Clause
%YAML 1.2
---
$id: http://devicetree.org/schemas/display/panel/samsung,ea8061s.yaml#
$schema: http://devicetree.org/meta-schemas/core.yaml#

title: Samsung EA8061S AMOLED DSI panel

maintainers:
  - Hendra Manudinata <manoedinata@gmail.com>

description:
  720x1280 AMOLED panel with a Samsung EA8061S driver IC in MIPI DSI video
  mode, as found in the Samsung Galaxy J4 (SM-J400F).

allOf:
  - $ref: panel-common.yaml#

properties:
  compatible:
    const: samsung,ea8061s

  reg:
    maxItems: 1

  vddio-supply:
    description: 1.8 V I/O supply of the panel

  enable-gpios:
    maxItems: 1
    description: Enables the 3.0 V load switch that powers the panel

  reset-gpios: true

  samsung,keep-bootloader-state:
    type: boolean
    description:
      The bootloader powered, reset and initialised the panel and its video
      stream is running. The first prepare() does not power-cycle or
      re-initialise it, since the panel locks to a stream that starts while
      it is being initialised. Later power cycles do a full initialisation.

required:
  - compatible
  - reg
  - vddio-supply
  - enable-gpios
  - reset-gpios

additionalProperties: false

examples:
  - |
    #include <dt-bindings/gpio/gpio.h>

    dsi {
        #address-cells = <1>;
        #size-cells = <0>;

        panel@0 {
            compatible = "samsung,ea8061s";
            reg = <0>;
            samsung,keep-bootloader-state;

            vddio-supply = <&ldo20_reg>;
            enable-gpios = <&gpd1 0 GPIO_ACTIVE_HIGH>;
            reset-gpios = <&gpd2 0 GPIO_ACTIVE_HIGH>;
        };
    };
```

## Documentation/devicetree/bindings/regulator/samsung,s2mpu06-pmic.yaml
```yaml
# SPDX-License-Identifier: (GPL-2.0-only OR BSD-2-Clause)
%YAML 1.2
---
$id: http://devicetree.org/schemas/regulator/samsung,s2mpu06-pmic.yaml#
$schema: http://devicetree.org/meta-schemas/core.yaml#

title: Samsung S2MPU06 PMIC

maintainers:
  - Hendra Manudinata <manoedinata@gmail.com>

description:
  The S2MPU06 is a PMIC with three bucks and twenty LDOs, a power key and
  more, reached over the SPEEDY bus of the Exynos7570. Regulators not
  listed in the regulators node are left as the bootloader configured them.

properties:
  compatible:
    const: samsung,s2mpu06-pmic

  reg:
    maxItems: 1

  interrupts:
    maxItems: 1
    description: Level-low interrupt line shared by all functions of the PMIC.

  monitored-battery:
    $ref: /schemas/types.yaml#/definitions/phandle
    description: Battery described by a simple-battery node, used by the fuel gauge.

  extcon:
    $ref: /schemas/types.yaml#/definitions/phandle-array
    maxItems: 1
    description:
      MUIC whose cable detection sets the input and charge current of the
      charger.

  io-channels:
    maxItems: 1
    description: ADC channel the battery thermistor is wired to.

  io-channel-names:
    const: adc-temp

  samsung,temp-adc-table:
    $ref: /schemas/types.yaml#/definitions/uint32-array
    minItems: 2
    maxItems: 64
    description: Raw ADC values of the thermistor lookup table, ascending.

  samsung,temp-decidegc-table:
    $ref: /schemas/types.yaml#/definitions/int32-array
    minItems: 2
    maxItems: 64
    description:
      Battery temperature in tenths of a degree Celsius for each value of
      samsung,temp-adc-table.

  samsung,capacity-max:
    $ref: /schemas/types.yaml#/definitions/uint32
    default: 1000
    description:
      Gauge reading, in tenths of a percent, that counts as 100 % of the
      capacity before the scale is stretched at the end of a charge.

  samsung,capacity-max-margin:
    $ref: /schemas/types.yaml#/definitions/uint32
    default: 0
    description:
      How far, in tenths of a percent, samsung,capacity-max may be adapted.

  samsung,fuel-alert-soc:
    $ref: /schemas/types.yaml#/definitions/uint32
    minimum: 0
    maximum: 15
    default: 1
    description: Capacity in percent below which the gauge raises its low-battery alert.

  samsung,age-cycles:
    $ref: /schemas/types.yaml#/definitions/uint32-array
    minItems: 1
    maxItems: 8
    description: Charge cycle count from which each ageing step applies, ascending.

  samsung,age-float-microvolt:
    $ref: /schemas/types.yaml#/definitions/uint32-matrix
    minItems: 1
    maxItems: 8
    items:
      maxItems: 1
    description: Charge float voltage of each ageing step.

  samsung,age-raw100-millivolt:
    $ref: /schemas/types.yaml#/definitions/uint32-array
    minItems: 1
    maxItems: 8
    description: Battery voltage at which the gauge reads 100 % in each ageing step.

  samsung,cell-character0:
    $ref: /schemas/types.yaml#/definitions/uint8-array
    description: The 164 bytes of cell characteristics (gauge registers 0x34..0xd7) of every step.

  samsung,cell-character1:
    $ref: /schemas/types.yaml#/definitions/uint8-array
    description: The 5 bytes of cell characteristics (gauge registers 0x0f..0x13) of every step.

  regulators:
    type: object
    description: Regulator nodes named after the rails.

    patternProperties:
      "^(LDO([1-8]|1[3-9]|2[0-4])|BUCK[1-3])$":
        type: object
        $ref: regulator.yaml#
        unevaluatedProperties: false

    additionalProperties: false

required:
  - compatible
  - reg
  - interrupts
  - regulators

additionalProperties: false

examples:
  - |
    #include <dt-bindings/interrupt-controller/irq.h>

    pmic@0 {
        compatible = "samsung,s2mpu06-pmic";
        reg = <0>;
        interrupt-parent = <&gpa0>;
        interrupts = <5 IRQ_TYPE_LEVEL_LOW>;
        monitored-battery = <&battery>;

        regulators {
            BUCK1 {
                regulator-name = "BUCK1";
                regulator-min-microvolt = <500000>;
                regulator-max-microvolt = <1300000>;
                regulator-always-on;
            };

            LDO14 {
                regulator-name = "vemmc";
                regulator-min-microvolt = <1800000>;
                regulator-max-microvolt = <3375000>;
            };
        };
    };
```

## Documentation/devicetree/bindings/soc/samsung/samsung,exynos7570-speedy.yaml
```yaml
# SPDX-License-Identifier: (GPL-2.0-only OR BSD-2-Clause)
%YAML 1.2
---
$id: http://devicetree.org/schemas/soc/samsung/samsung,exynos7570-speedy.yaml#
$schema: http://devicetree.org/meta-schemas/core.yaml#

title: Samsung Exynos SPEEDY (one-wire PMIC bus) controller

maintainers:
  - Hendra Manudinata <manoedinata@gmail.com>

description:
  SPEEDY (Serial Protocol in an EffEctive Digital waY) is the one-wire
  bus that connects the application processor to its PMIC. The slave
  exposes up to 16 register blocks of 256 registers; child nodes
  describe the slave devices.

properties:
  compatible:
    const: samsung,exynos7570-speedy

  reg:
    maxItems: 1

  interrupts:
    maxItems: 1

  clocks:
    maxItems: 2

  clock-names:
    items:
      - const: pclk
      - const: clk

  samsung,always-interrupt-high:
    type: boolean
    description:
      Program the FIFO trigger levels so that the IP interrupt line stays
      high while the IP batcher runs, which the batcher needs to avoid a
      timeout.

  "#address-cells":
    const: 1

  "#size-cells":
    const: 0

patternProperties:
  "^pmic@[0-9a-f]+$":
    $ref: /schemas/regulator/samsung,s2mpu06-pmic.yaml

required:
  - compatible
  - reg
  - interrupts
  - clocks
  - clock-names

additionalProperties: false

examples:
  - |
    #include <dt-bindings/clock/samsung,exynos7570-cmu.h>
    #include <dt-bindings/interrupt-controller/arm-gic.h>

    bus@10510000 {
        compatible = "samsung,exynos7570-speedy";
        reg = <0x10510000 0x2000>;
        interrupts = <GIC_SPI 372 IRQ_TYPE_LEVEL_HIGH>;
        clocks = <&cmu_mif CLK_GOUT_MIF_SPEEDY_PCLK>,
                 <&cmu_mif CLK_GOUT_MIF_SPEEDY_CLK>;
        clock-names = "pclk", "clk";
        samsung,always-interrupt-high;
        #address-cells = <1>;
        #size-cells = <0>;

        pmic@0 {
            compatible = "samsung,s2mpu06-pmic";
            reg = <0>;

            regulators {
                LDO1 {
                    regulator-name = "vdd_ldo1";
                    regulator-min-microvolt = <500000>;
                    regulator-max-microvolt = <1300000>;
                };
            };
        };
    };
```

## drivers/misc/modem_v1/Kconfig
```kconfig
# SPDX-License-Identifier: GPL-2.0-only
config SAMSUNG_MODEM_V1
	tristate "Samsung Shannon modem interface (downstream modem_v1)"
	depends on ARM64 && OF && HAVE_ARM_SMCCC
	depends on ARCH_EXYNOS || COMPILE_TEST
	select MFD_SYSCON
	help
	  The modem interface of Samsung's downstream kernels for the
	  Exynos7570's Shannon modem (SS305AP) over shared memory, as on the
	  Galaxy J4: the CP mailbox (mcu_ipc), the shared memory layout
	  (shm_ipc), the secure-boot CP control and the SIPC5 link with its
	  io devices (/dev/umts_boot0, umts_ipc0/1, umts_rfs0, rmnet0-7).
	  Userspace boots and drives the modem with libsamsung-ipc
	  (samsungipcd).

	  To compile this as a module, choose M here: the module will be
	  called modem_if.
```
