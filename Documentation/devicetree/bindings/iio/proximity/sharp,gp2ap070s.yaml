## Documentation/devicetree/bindings/iio/proximity/sharp,gp2ap070s.yaml
```yaml
# SPDX-License-Identifier: (GPL-2.0-only OR BSD-2-Clause)
%YAML 1.2
---
$id: http://devicetree.org/schemas/iio/proximity/sharp,gp2ap070s.yaml#
$schema: http://devicetree.org/meta-schemas/core.yaml#

title: Sharp GP2AP070S proximity sensor

maintainers:
  - Hendra Manudinata <manoedinata@gmail.com>

description:
  I2C proximity sensor with its own IR LED. The interrupt line follows the
  near/far state the chip keeps with its threshold hysteresis.

allOf:
  - $ref: /schemas/iio/iio.yaml#

properties:
  compatible:
    const: sharp,gp2ap070s

  reg:
    maxItems: 1

  interrupts:
    maxItems: 1

  vdd-supply: true

  proximity-near-level: true

required:
  - compatible
  - reg

additionalProperties: false

examples:
  - |
    #include <dt-bindings/interrupt-controller/irq.h>

    i2c {
        #address-cells = <1>;
        #size-cells = <0>;

        proximity@39 {
            compatible = "sharp,gp2ap070s";
            reg = <0x39>;
            interrupt-parent = <&gpa1>;
            interrupts = <0 IRQ_TYPE_EDGE_BOTH>;
            vdd-supply = <&ldo22_reg>;
            proximity-near-level = <110>;
        };
    };
```

## drivers/misc/samsung/scsc_bt/Kconfig
```kconfig
config SCSC_BT
	tristate "SCSC MX BT support"
	depends on SCSC_CORE && BT

config SCSC_BT_BLUEZ
	bool "SCSC MX BlueZ support"
	depends on SCSC_BT && RFKILL
	help
	  Register the WLBT Bluetooth function as a BlueZ HCI device
	  (H4 over the shared memory link), switched by rfkill.
```
